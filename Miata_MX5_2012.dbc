VERSION ""

NS_ :

BS_:

BU_: XXX

BO_ 129 NEW_MSG_1: 8 XXX

BO_ 1072 NEW_MSG_2: 8 XXX

BO_ 513 NEW_MSG_3: 8 XXX
 SG_ Interestining_sig_1  : 24|16@1+ (1,0) [0|65535] "" XXX
